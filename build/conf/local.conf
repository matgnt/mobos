## build/conf/local.conf
```bitbake
# Where to store sources
DL_DIR = "${OETREE}/downloads"

#INHERIT += " rm_work "

# Make sure you have these installed
ASSUME_PROVIDED += "gdk-pixbuf-csource-native imagemagick-native librsvg-native"

# Which files do we want to parse:
BBFILES := "${OETREE}/build/recipes/*/*.bb ${OETREE}/openembedded/recipes/*/*.bb"

# Use the BBMASK below to instruct BitBake to _NOT_ consider some .bb files
# This is a regulary expression, so be sure to get your parenthesis balanced.
BBMASK = ""
 
# What kind of images do we want?
IMAGE_FSTYPES += "tar.bz2 jffs2"

# Set TMPDIR instead of defaulting it to $pwd/tmp
#TMPDIR = "${OETREE}/${DISTRO}-stable"
TMPDIR = "${OETREE}/${DISTRO}-oe-dev"
#TMPDIR = "${OETREE}/${DISTRO}-oe-qt"

# Make use of SMP and fast disks
PARALLEL_MAKE = "-j5"
#BB_NUMBER_THREADS = "4"

DISTRO = "angstrom-2008.1"

MACHINE = "topas910"
PREFERRED_PROVIDER_virtual/kernel = "linux-topas910"
# zImage for odl 2.6.26 kernel
#KERNEL_IMAGETYPE_topas910 = "zImage"
# uImage for u-boot
KERNEL_IMAGETYPE_topas910 = "uImage"
CMDLINE = "root=/dev/nfs rw nfsroot=192.168.1.1:/home/devel/nfs ip=192.168.1.2:192.168.1.1:192.168.1.1:255.255.255.0:topas910::off console=ttyS0,115200 debug"
#CMDLINE = "root=/dev/nfs rw nfsroot=192.168.1.1:/home/devel/nfs ip=192.168.1.2:192.168.1.1::255.255.255.0:topas910::off console=/dev/null"
# to remove the automatically added "debug" at the end
#CMDLINE_DEBUG = ""
UBOOT_ENTRYPOINT= "0x20060000"

TERMCMD = "${SCREEN_TERMCMD}"
TERMCMDRUN = "${SCREEN_TERMCMDRUN}"

SCREEN_TERMCMD = 'screen -D -m -t "$TERMWINDOWTITLE"'
SCREEN_TERMCMDRUN = '${SCREEN_TERMCMD} $SHELLCMDS'

#SCREEN_TERMCMD = 'screen -D -m -t "$TERMWINDOWTITLE" -s /bin/bash'
#TERMCMD = "${SCREEN_TERMCMD}"
#TERMCMDRUN = "${SCREEN_TERMCMDRUN}"

# Btbake Collections / Overlay
BBFILE_COLLECTIONS = "upstream local"
BBFILE_PATTERN_upstream = "^${OETREE}/openembedded/recipes/"
BBFILE_PATTERN_local = "^${OETREE}/build/recipes/"
BBFILE_PRIORITY_upstream = "5"
BBFILE_PRIORITY_local = "10"

#### If you see git-fetch bugs...
#BB_GIT_CLONE_FOR_SRCREV = "1"

#with angstrom distribution this variables are overwritten - see below
#PREFERRED_VERSION_qt4-x11-free = "4.7.0-beta1"
#PREFERRED_VERSION_qt4-tools-native = "4.7.0-beta1"
#overwrite the angstrom distro variable
ANGSTROM_QT_VERSION = "4.7.0-beta1"

# ofono
PREFERRED_VERSION_ofono = "git"

# to get overlay recipe ofono working - temporary
# OE_ALLOW_INSECURE_DOWNLOADS = "1"

# to get ofono working, a libc with signalfd is necessary
#PREFERRED_VERSION_glibc = "2.9"
#PREFERRED_VERSION_glibc-initial = "2.9"

# So far, angstrom.conf sets ENABLE_BINARY_LOCALE_GENERATION
# to generate binary locale packages at build time using qemu-native and
# thereby guarantee i18n support on all devices. If your build breaks on 
# qemu-native consider disabling ENABLE_BINARY_LOCALE_GENERATION (note that
# this breaks i18n on devices with less than 128MB RAM) or installing
# a working third-party qemu (e.g. provided by your distribution) and
# adding qemu-native to ASSUME_PROVIDED. Caveat emptor, since third-party
# qemus lack patches needed to work with various OE targets.
ENABLE_BINARY_LOCALE_GENERATION = "0"
# ASSUME_PROVIDED += "qemu-native"

# If ENABLE_BINARY_LOCALE_GENERATION is set to "1", you can limit locales
# generated to the list provided by GLIBC_GENERATE_LOCALES. This is huge
# time-savior for developmental builds. Format: list of locale.encoding pairs
# with spaces as separators.
GLIBC_GENERATE_LOCALES = "en_GB.UTF-8 de_DE.UTF-8"
```
